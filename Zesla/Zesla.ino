// generated by mBlock5 for mBot Ranger
// codes make you happy

#include <Arduino.h>
#include <Wire.h>
#include <SoftwareSerial.h>
#include <MeAuriga.h>

int GAUCHE_NOIR_DROIT_NOIR = 0;
int GAUCHE_NOIR_DROIT_BLANC = 1;
int GAUCHE_BLANC_DROIT_NOIR = 2;
int GAUCHE_BLANC_DROIT_BLANC = 3;

int TOUT_DROIT = 1;
int GAUCHE = 3;
int DROITE = 4;
int MARCHE_ARRIERE = 2;

int SEUIL_LEDS_A_ALLUMER = 100;
int SEUIL_LEDS_A_MAINTENIR_ALLUMEES = 700;
int SEUIL_LEDS_A_ETEINDRE = 900;

MeLightSensor capteurLumiere_1(12);
MeLightSensor capteurLumiere_2(11);
MeLineFollower capteurLigne(9);
MeEncoderOnBoard Encoder_1(SLOT1);
MeEncoderOnBoard Encoder_2(SLOT2);
MeUltrasonicSensor capteurObstacle(10);
MeBuzzer buzzer;
MeRGBLed led(0, 12);

int HEURE_ARRET = 0;

void debug(String message) {
  Serial.print(message);
  Serial.print("\n");
}

void isr_process_encoder1(void)
{
  if(digitalRead(Encoder_1.getPortB()) == 0){
    Encoder_1.pulsePosMinus();
  }else{
    Encoder_1.pulsePosPlus();
  }
}
void isr_process_encoder2(void)
{
  if(digitalRead(Encoder_2.getPortB()) == 0){
    Encoder_2.pulsePosMinus();
  }else{
    Encoder_2.pulsePosPlus();
  }
}
void se_deplacer(int direction, int speed)
{
  int leftSpeed = 0;
  int rightSpeed = 0;
  if(direction == TOUT_DROIT){
    leftSpeed = -speed;
    rightSpeed = speed;
  }else if(direction == MARCHE_ARRIERE){
    leftSpeed = speed;
    rightSpeed = -speed;
  }else if(direction == GAUCHE){
    leftSpeed = -speed;
    rightSpeed = -speed;
  }else if(direction == DROITE){
    leftSpeed = speed;
    rightSpeed = speed;
  }
  Encoder_1.setTarPWM(leftSpeed);
  Encoder_2.setTarPWM(rightSpeed);
}

void _delay(float seconds) {
  if(seconds < 0.0){
    seconds = 0.0;
  }
  long endTime = millis() + seconds * 1000;
  while(millis() < endTime) delay(10);
}

int recuperer_etat_de_la_ligne() {
  return capteurLigne.readSensors();
}

int recuperer_distance() {
  return capteurObstacle.distanceCm();
}

int recuperer_luminosite() {  
  return (capteurLumiere_1.read() + capteurLumiere_2.read()) / 2.0;
}

void colorer_leds(int rouge, int vert, int bleu, int nombreDeLeds) {
  for(int numeroLed = 0; numeroLed < nombreDeLeds; numeroLed++) {
    led.setColor(numeroLed, rouge, vert, bleu);
  }
  for(int numeroLed = nombreDeLeds; numeroLed < 12; numeroLed++) {
    led.setColor(numeroLed, 0, 0, 0);
  }
  led.show();
}

int calculer_temps_arret() {
  if(HEURE_ARRET == 0) {
    HEURE_ARRET = millis();
  }
  return (millis() - HEURE_ARRET) / 1000;
}

void setup() {
  //Serial.end();
  Serial.begin(115200);
  Encoder_1.reset(SLOT1);
  Encoder_2.reset(SLOT2);

  buzzer.setpin(45);
  led.setpin(44);
  led.fillPixelsBak(0, 2, 1);

  //Set PWM 8KHz
  TCCR1A = _BV(WGM10);
  TCCR1B = _BV(CS11) | _BV(WGM12);
  TCCR2A = _BV(WGM21) | _BV(WGM20);
  TCCR2B = _BV(CS21);
}

void loop() {
  
  float vitesse;
  int distance = recuperer_distance();
  int direction = TOUT_DROIT;
  int etat_de_la_ligne = recuperer_etat_de_la_ligne();
  boolean allumerPhares = false;
  boolean allumerFeuxRecul = false;

  if(etat_de_la_ligne == GAUCHE_BLANC_DROIT_BLANC) {
    direction = TOUT_DROIT;
    vitesse = 150;
  } 
  else {
    if(etat_de_la_ligne == GAUCHE_NOIR_DROIT_BLANC) {
      direction = DROITE;
      vitesse = 120;
    } 
    else {
      if(etat_de_la_ligne == GAUCHE_BLANC_DROIT_NOIR) {
        direction = GAUCHE;
        vitesse = 120;
      } 
      else {
        direction = MARCHE_ARRIERE;
        vitesse = 150;
        allumerFeuxRecul = true;
      }
    }
  }
  
  int valeurLuminosite = recuperer_luminosite();
  if (valeurLuminosite < SEUIL_LEDS_A_ALLUMER || 
      (valeurLuminosite > SEUIL_LEDS_A_MAINTENIR_ALLUMEES && valeurLuminosite < SEUIL_LEDS_A_ETEINDRE )) {
    allumerPhares = true;
  }

  if(distance < 10){
    vitesse = 0;

    if(calculer_temps_arret() == 0) {
      buzzer.tone(500, 1000);
    }
    else if(calculer_temps_arret() > 15) {
      buzzer.tone(500, 1000);
      direction = MARCHE_ARRIERE;
      vitesse = 150;
      allumerFeuxRecul = true;
    }
  } 
  else if (distance < 20) {
    HEURE_ARRET = 0;
    vitesse = 100;
    allumerPhares = true;
  }
  else {
    HEURE_ARRET = 0;
  }

  if(allumerFeuxRecul) {
      colorer_leds(255, 0, 0, 12);
  }
  else if(allumerPhares) {
    colorer_leds(255, 255, 255, 12);
  } 
  else {
      colorer_leds(0, 0, 0, 12);
  }

  se_deplacer(direction, vitesse);
        
  Encoder_1.loop();
  Encoder_2.loop();
}
